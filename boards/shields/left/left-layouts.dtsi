/ {
    physical_layout0: physical_layout_0 {
        compatible = "zmk,physical-layout";
        display-name = "Default Layout";
    };
};

&physical_layout0 {
    transform = <&default_transform>; // Label of the matrix transform this layout uses
};
